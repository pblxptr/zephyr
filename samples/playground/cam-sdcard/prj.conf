## CMakeLists.txt
```
#-------------------------------------------------------------------------------
# Zephyr Example Application
#
# Copyright (c) 2021 Nordic Semiconductor ASA
# SPDX-License-Identifier: Apache-2.0

cmake_minimum_required(VERSION 3.13.1)
find_package(Zephyr REQUIRED HINTS $ENV{ZEPHYR_BASE})

project(app LANGUAGES C)

target_sources(app PRIVATE 
    src/main.c 
    src/cam_operations.c
    src/fs_operations.c
)
```

## Kconfig
```
# Copyright (c) 2021 Nordic Semiconductor ASA
# SPDX-License-Identifier: Apache-2.0
#
# This file is the application Kconfig entry point. All application Kconfig
# options can be defined here or included via other application Kconfig files.
# You can browse these options using the west targets menuconfig (terminal) or
# guiconfig (GUI).

# menu "Zephyr"
# source "Kconfig.zephyr"
# endmenu

module = APP
module-str = APP
source "subsys/logging/Kconfig.template.log_config"

mainmenu "Video capture sample application"

menu "Video capture configuration"

config VIDEO_FORMAT_HEIGHT
	int "Height of the video format"
	default 0
	help
	  Height of the video format. If set to 0, the default height is used.

config VIDEO_FORMAT_WIDTH
	int "Width of the video format"
	default 0
	help
	  Width of the video format. If set to 0, the default width is used.

config VIDEO_PIXEL_FORMAT
	string "Pixel format of the video format"
	help
	  Pixel format of the video format. If not set, the default pixel format is used.

# config HEAP_MEM_POOL_ADD_SIZE_BOARD
# 	int
# 	default 8192

config HEAP_MEM_POOL_ADD_SIZE_BOARD
	int
	default 65535 if WIFI && BT
	default 65535 if WIFI
	default 40960 if BT
	default 4096

endmenu

source "Kconfig.zephyr"
```

## prj.conf
```kconfig
# Copyright (c) 2021 Nordic Semiconductor ASA
# SPDX-License-Identifier: Apache-2.0
#
# This file contains selected Kconfig options for the application.
CONFIG_SENSOR=y
CONFIG_SHELL=y

CONFIG_DMA=y

# Memory
CONFIG_ESP_SPIRAM=y
CONFIG_SPIRAM_MODE_OCT=y

# Kernel
CONFIG_TEST_RANDOM_GENERATOR=y
CONFIG_SYS_HEAP_RUNTIME_STATS=y
CONFIG_STACK_SENTINEL=y
CONFIG_INIT_STACKS=y
CONFIG_WATCHDOG=y
CONFIG_THREAD_MONITOR=y

## LOGS
CONFIG_LOG=y
# CONFIG_LOG_MODE_IMMEDIATE=y
# CONFIG_VIDEO_LOG_LEVEL_DBG=y

## SD CARD
CONFIG_FAT_FILESYSTEM_ELM=y
CONFIG_DISK_ACCESS=y
CONFIG_FILE_SYSTEM=y
CONFIG_DISK_DRIVER_SDMMC=y
CONFIG_FILE_SYSTEM_SHELL=y
CONFIG_FILE_SYSTEM_MKFS=y

## Camera
CONFIG_VIDEO=y
CONFIG_VIDEO_SW_GENERATOR=y
CONFIG_VIDEO_BUFFER_POOL_SZ_MAX=40000
CONFIG_VIDEO_BUFFER_POOL_NUM_MAX=4
CONFIG_ESP_SPIRAM=y
CONFIG_SPIRAM_MODE_OCT=y
CONFIG_VIDEO_BUFFER_POOL_ALIGN=32
CONFIG_DMA_ESP32_MAX_DESCRIPTOR_NUM=64
CONFIG_VIDEO_BUFFER_USE_SHARED_MULTI_HEAP=y
CONFIG_VIDEO_BUFFER_SMH_ATTRIBUTE=2
CONFIG_VIDEO_FORMAT_HEIGHT=240
CONFIG_VIDEO_FORMAT_WIDTH=320
CONFIG_VIDEO_PIXEL_FORMAT="RGBP"
```

## src/main.c
```c
/*
 * Copyright (c) 2019 Tavish Naruka <tavishnaruka@gmail.com>
 * Copyright (c) 2023 Nordic Semiconductor ASA
 * Copyright (c) 2023 Antmicro <www.antmicro.com>
 *
 * SPDX-License-Identifier: Apache-2.0
 */

/* Sample which uses the filesystem API and SDHC driver */

#include <zephyr/kernel.h>
#include <zephyr/device.h>
#include <zephyr/fs/fs.h>
#include <zephyr/shell/shell.h>
#include <zephyr/logging/log.h>

#include "fs_operations.h"
#include "cam_operations.h"

LOG_MODULE_REGISTER(main);

#define MAX_PATH 128
#define DISK_DRIVE_NAME "SD"
#define DISK_MOUNT_PT "/"DISK_DRIVE_NAME":"

static const char *disk_drive_name = DISK_DRIVE_NAME;
static const char *disk_mount_pt = DISK_MOUNT_PT;

static int shell_lsdir(const struct shell *sh, size_t argc, char **argv)
{
    int res = fs_op_lsdir(DISK_MOUNT_PT);
    if (res != 0) {
        LOG_ERR("Error showing dir's content");
    }

	return 0;
}

static int shell_umount(const struct shell *sh, size_t argc, char **argv)
{
    fs_op_deinit();

    LOG_INF("umount done");

	return 0;
}

SHELL_CMD_REGISTER(lsdir, NULL, "ls dir", shell_lsdir);
SHELL_CMD_REGISTER(umount, NULL, "umount dir", shell_umount);

#define SAMPLE_FNAME "frame-"
#define CHUNK_SIZE 64

int write_frame(int num, char *buffer, size_t len)
{
    static char path[MAX_PATH];
    struct fs_file_t file;
    int ret;
    int base = strlen(disk_mount_pt);
	fs_file_t_init(&file);
    strncpy(path, disk_mount_pt, sizeof(path));

    path[base++] = '/';
    path[base] = 0;
    // strcat(&path[base], SAMPLE_FNAME);
    snprintf(&path[base], sizeof(path) - base, "%s%d", SAMPLE_FNAME, num);

	if (fs_open(&file, path, FS_O_CREATE | FS_O_WRITE)) {
		LOG_ERR("Failed to create file %s", path);
		return -1;
	}

    ret = fs_truncate(&file, len);
    if (ret) {
        LOG_ERR("Failed to truncate file");
        fs_close(&file);
        return ret;
    }

    ret = fs_seek(&file, 0, FS_SEEK_SET);
    if (ret) {
        LOG_ERR("Failed to seek to start");
        return -1;
    }

    /* Full write */
    LOG_INF("writing file: size: %u", len);
    ret = fs_write(&file, buffer, len);
    if (ret < 0) {
        LOG_ERR("Cannot write file");
	    fs_close(&file);
        return ret;
    }

    if (ret != len) {
        LOG_ERR("errno: %d", errno);
        fs_close(&file);
        return ret;
    }
    /* Full write end */

    fs_sync(&file);
	fs_close(&file);

    return 0;
}


int grab_and_save(struct camera *video, int num)
{
    int ret;
    struct video_buffer *vbuf;

    ret = camera_frame_get(video, &vbuf);
    if (ret) {
        return ret;
    }
    LOG_INF("camera got frame, ptr %p!", vbuf);

    camera_stream_stop(video);

    ret = write_frame(num, vbuf->buffer, vbuf->bytesused);
    if (ret) {
        return ret;
    }
    
    camera_setup_buffers(video);
    camera_stream_start(video);

    // ret = camera_frame_put(video, vbuf);
    // if (ret) {
    //     LOG_ERR("Unable to requeue video buf");
    //     return ret;
    // }

    LOG_INF("Done!");

    return 0;
}

int grab_and_do_nothing(struct camera *video)
{
    int ret;
    struct video_buffer *vbuf;

    ret = camera_frame_get(video, &vbuf);
    if (ret) {
        LOG_ERR("Unable to dequeue video buf");
        return ret;
    }

    ret = camera_frame_put(video, vbuf);
    if (ret) {
        LOG_ERR("Unable to requeue video buf");
        return ret;
    }

    return 0;
}

#define MKFS_FS_TYPE FS_FATFS
#define MKFS_DEV_ID "SD:"
#define MKFS_FLAGS 0

int main()
{
	unsigned int frame = 0;
    struct camera *video = k_malloc(sizeof(struct camera));
    memset(video, 0, sizeof(*video));
    int ret;
    int i;

    ret = fs_op_init(disk_drive_name, disk_mount_pt);
    if (ret) {
        return ret;
    }

    k_sleep(K_MSEC(1000));
    LOG_INF("mounted drive!");

    ret = camera_init(video);
    if (ret) {
        return ret;
    }
    LOG_INF("camera init done!");

    ret = camera_setup_buffers(video);
    if (ret) {
        return ret;
    }

    ret = camera_stream_start(video);
    if (ret) {
        return ret;
    }
    LOG_INF("camera stream started!");


    // for (i = 0; i < 10; i++) {
    if (grab_and_save(video, 2)) {
        LOG_ERR("Cannot grab and save");
        k_sleep(K_MSEC(1000));
        return -1;
    }
    // }
    camera_stream_stop(video);
    k_free(video);

    LOG_INF("done");
}
```

## src/cam_operations.c
```c
#include "cam_operations.h"

#include <zephyr/logging/log.h>

LOG_MODULE_DECLARE(main);

int camera_init(struct camera *video)
{
	struct video_format fmt;
	struct video_frmival frmival;
	struct video_frmival_enum fie;
	struct video_caps caps;
    size_t bsize;
	int i;

	const struct device *const dev = DEVICE_DT_GET(DT_CHOSEN(zephyr_camera));

    if (!device_is_ready(dev)) {
		LOG_ERR("%s: video device not ready.", video->dev->name);
		return 0;
	}
    video->dev = dev;


	LOG_INF("Video device: %s", video->dev->name);

	/* Get capabilities */
	if (video_get_caps(video->dev, VIDEO_EP_OUT, &caps)) {
		LOG_ERR("Unable to retrieve video capabilities");
		return 0;
	}

	printk("- Capabilities:\n");
	while (caps.format_caps[i].pixelformat) {
		const struct video_format_cap *fcap = &caps.format_caps[i];
		/* fourcc to string */
		LOG_INF("  %c%c%c%c width [%u; %u; %u] height [%u; %u; %u]",
		       (char)fcap->pixelformat, (char)(fcap->pixelformat >> 8),
		       (char)(fcap->pixelformat >> 16), (char)(fcap->pixelformat >> 24),
		       fcap->width_min, fcap->width_max, fcap->width_step, fcap->height_min,
		       fcap->height_max, fcap->height_step);
		i++;
	}
	

	/* Get default/native format */
	if (video_get_format(video->dev, VIDEO_EP_OUT, &fmt)) {
		LOG_ERR("Unable to retrieve video format");
		return -1;
	}

	LOG_INF("- Default format: %c%c%c%c %ux%u", (char)fmt.pixelformat,
	       (char)(fmt.pixelformat >> 8), (char)(fmt.pixelformat >> 16),
	       (char)(fmt.pixelformat >> 24), fmt.width, fmt.height);

	if (!video_get_frmival(video->dev, VIDEO_EP_OUT, &frmival)) {
		LOG_ERR("- Default frame rate : %f fps\n",
		       1.0 * frmival.denominator / frmival.numerator);
	}

	LOG_INF("- Supported frame intervals for the default format:");
	memset(&fie, 0, sizeof(fie));
	fie.format = &fmt;
	while (video_enum_frmival(video->dev, VIDEO_EP_OUT, &fie) == 0) {
		if (fie.type == VIDEO_FRMIVAL_TYPE_DISCRETE) {
			LOG_INF("   %u/%u ", fie.discrete.numerator, fie.discrete.denominator);
		} else {
			LOG_INF("   [min = %u/%u; max = %u/%u; step = %u/%u]",
			       fie.stepwise.min.numerator, fie.stepwise.min.denominator,
			       fie.stepwise.max.numerator, fie.stepwise.max.denominator,
			       fie.stepwise.step.numerator, fie.stepwise.step.denominator);
		}
		fie.index++;
	}

	/* Apply format from config */
	#if CONFIG_VIDEO_FORMAT_HEIGHT
		fmt.height = CONFIG_VIDEO_FORMAT_HEIGHT;
	#endif

	#if CONFIG_VIDEO_FORMAT_WIDTH
		fmt.width = CONFIG_VIDEO_FORMAT_WIDTH;
		fmt.pitch = fmt.width * 2;
	#endif

	if (strcmp(CONFIG_VIDEO_PIXEL_FORMAT, "")) {
		fmt.pixelformat =
			video_fourcc(CONFIG_VIDEO_PIXEL_FORMAT[0], CONFIG_VIDEO_PIXEL_FORMAT[1],
				     CONFIG_VIDEO_PIXEL_FORMAT[2], CONFIG_VIDEO_PIXEL_FORMAT[3]);
	}

	LOG_INF("- Video format: %c%c%c%c %ux%u", (char)fmt.pixelformat,
	       (char)(fmt.pixelformat >> 8), (char)(fmt.pixelformat >> 16),
	       (char)(fmt.pixelformat >> 24), fmt.width, fmt.height);

	if (video_set_format(video->dev, VIDEO_EP_OUT, &fmt)) {
		LOG_ERR("Unable to set format");
		return 0;
	}
	LOG_INF("Format set");

	bsize = fmt.pitch * fmt.height; // For 240x240 = 115200

    // Allocate buffers 
	for (i = 0; i < ARRAY_SIZE(video->buffers); i++) {
		video->buffers[i] = video_buffer_aligned_alloc(bsize, CONFIG_VIDEO_BUFFER_POOL_ALIGN);
		if (video->buffers[i] == NULL) {
			LOG_ERR("Unable to alloc video buffer");
			return -1;
		}
	}

    return 0;
}

int camera_setup_buffers(struct camera *video)
{
	int ret;
	int i;
    for (i = 0; i < ARRAY_SIZE(video->buffers); i++) {
        LOG_INF(" - equeue buffer");
        ret = video_enqueue(video->dev, VIDEO_EP_OUT, video->buffers[i]);
		if (ret) {
			LOG_ERR("Cannot enqueue buffer");
			return ret;
		}
	}
	return 0;
}

int camera_stream_start(struct camera *video)
{
    /* Start video capture */
    if (video_stream_start(video->dev)) {
        LOG_ERR("Unable to start video");
        return -1;
    }

    return 0;
}

int camera_stream_stop(struct camera *video)
{
    video_stream_stop(video->dev);

	return 0;
}

int camera_frame_get(struct camera *video, struct video_buffer **vbuf)
{
    int ret = video_dequeue(video->dev, VIDEO_EP_OUT, vbuf, K_MSEC(5000));
    if (ret) {
        LOG_ERR("Unable to dequeue video buf");
        return -1;
    }
    return 0;
}

int camera_frame_put(struct camera *video, struct video_buffer *vbuf)
{
    int ret = video_enqueue(video->dev, VIDEO_EP_OUT, vbuf);
    if (ret) {
        LOG_ERR("Unable to enqueue video buf");
        return -1;
    }
    return 0;
}
```

## src/cam_operations.h
```c
#pragma once

#include <zephyr/drivers/video.h>

struct camera {
    const struct device *dev;
	struct video_buffer *buffers[2]; //CONFIG_VIDEO_BUFFER_POOL_NUM_MAX
};

int camera_init(struct camera *video);
int camera_setup_buffers(struct camera *video);
int camera_stream_start(struct camera *video);
int camera_stream_stop(struct camera *video);
int camera_frame_get(struct camera *video, struct video_buffer **vbuf);
int camera_frame_put(struct camera *video, struct video_buffer *buffer);
```

## src/fs_operations.c
```c
#include "fs_operations.h"

#include <zephyr/logging/log.h>

LOG_MODULE_DECLARE(main);

#if defined(CONFIG_FAT_FILESYSTEM_ELM)
#include <zephyr/storage/disk_access.h>
#include <zephyr/fs/fs.h>
#include <ff.h>

#else
#error "CONFIG_FAT_FILESYSTEM_ELM must be specified."
#endif

static FATFS fat_fs;
static struct fs_mount_t mp = {
	.type = FS_FATFS,
	.fs_data = &fat_fs,
};
#define FS_RET_OK FR_OK



int fs_op_init(const char *disk_drive_name, const char* mnt_pt)
{
	/* raw disk i/o */
	do {
		uint64_t memory_size_mb;
		uint32_t block_count;
		uint32_t block_size;

		if (disk_access_ioctl(disk_drive_name,
				DISK_IOCTL_CTRL_INIT, NULL) != 0) {
			LOG_ERR("Storage init ERROR!");
			break;
		}

		if (disk_access_ioctl(disk_drive_name,
				DISK_IOCTL_GET_SECTOR_COUNT, &block_count)) {
			LOG_ERR("Unable to get sector count");
			break;
		}

		if (disk_access_ioctl(disk_drive_name,
				DISK_IOCTL_GET_SECTOR_SIZE, &block_size)) {
			LOG_ERR("Unable to get sector size");
			break;
		}

		memory_size_mb = (uint64_t)block_count * block_size;

		if (disk_access_ioctl(disk_drive_name,
				DISK_IOCTL_CTRL_DEINIT, NULL) != 0) {
			LOG_ERR("Storage deinit ERROR!");
			break;
		}

	    LOG_INF("Block count %u", block_count);
		LOG_INF("Sector size %u", block_size);
		LOG_INF("Memory Size(MB) %u", (uint32_t)(memory_size_mb >> 20));
	} while (0);

	mp.mnt_point = mnt_pt;

	int res = fs_mount(&mp);
	if (res == FS_RET_OK) {
		LOG_INF("Disk mounted");
		/* Try to unmount and remount the disk */
		res = fs_unmount(&mp);
		if (res != FS_RET_OK) {
			LOG_ERR("Error unmounting disk");
			return res;
		}
		res = fs_mount(&mp);
		if (res != FS_RET_OK) {
			LOG_ERR("Error remounting disk");
			return res;
		}
	} else {
		LOG_ERR("Error mounting disk");
        return res;
	}
    return FS_RET_OK;
}

int fs_op_lsdir(const char *path)
{
	int res;
	struct fs_dir_t dirp;
	static struct fs_dirent entry;
	int count = 0;

	fs_dir_t_init(&dirp);

	/* Verify fs_opendir() */
	res = fs_opendir(&dirp, path);
	if (res) {
		printk("Error opening dir %s [%d]\n", path, res);
		return res;
	}

	printk("\nListing dir %s ...\n", path);
	for (;;) {
		/* Verify fs_readdir() */
		res = fs_readdir(&dirp, &entry);

		/* entry.name[0] == 0 means end-of-dir */
		if (res || entry.name[0] == 0) {
			break;
		}

		if (entry.type == FS_DIR_ENTRY_DIR) {
			printk("[DIR ] %s\n", entry.name);
		} else {
			printk("[FILE] %s (size = %zu)\n",
				entry.name, entry.size);
		}
		count++;
	}

	/* Verify fs_closedir() */
	fs_closedir(&dirp);
	if (res == 0) {
		res = count;
	}

	return res;
}

int fs_op_deinit(void)
{
	int res = fs_unmount(&mp);
    if (res != FS_RET_OK) {
        LOG_ERR("Error unmouting the disk");
    }
    return res;
}
```

## src/fs_operations.h
```c
#include <stdbool.h>



int fs_op_init(const char *disk_drive_name, const char *mnt_pt);
int fs_op_lsdir(const char *path);
int fs_op_deinit(void);
```

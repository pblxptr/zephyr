## drivers/sensor/adi/adxl345/Kconfig
```kconfig
# ADXL345, 3-Axis, +/-16g Digital Accelerometer

# Copyright (c) 2020 Antmicro <www.antmicro.com>
# SPDX-License-Identifier: Apache-2.0

config ADXL345
	bool "ADXL345 Three Axis accelerometer"
	default y
	depends on DT_HAS_ADI_ADXL345_ENABLED
	select I2C if $(dt_compat_on_bus,$(DT_COMPAT_ADI_ADXL345),i2c)
	select SPI if $(dt_compat_on_bus,$(DT_COMPAT_ADI_ADXL345),spi)
	help
	  Enable driver for ADXL345 Three-Axis Digital Accelerometer.


if ADXL345

choice
	prompt "Trigger mode"
	default ADXL345_TRIGGER_GLOBAL_THREAD
	help
	  Specify the type of triggering to be used by the driver.

config ADXL345_TRIGGER_NONE
	bool "No trigger"

config ADXL345_TRIGGER_GLOBAL_THREAD
	bool "Use global thread"
	select ADXL345_TRIGGER

config ADXL345_TRIGGER_OWN_THREAD
	bool "Use own thread"
	select ADXL345_TRIGGER
endchoice

config ADXL345_TRIGGER
	bool

config ADXL345_ACTIVITY_THRESHOLD
	int "Activity upper threshold value"
	default 1000
	help
	  Unsigned value that the ADXL345 samples are
	  compared to in activity trigger mode.

config ADXL345_INACTIVITY_THRESHOLD
	int "Inactivity upper threshold value"
	default 1000
	help
	  Unsigned value that the ADXL345 samples are
	  compared to in inactivity trigger mode.

config ADXL345_ACTIVITY_AXES
	string "Axes included in activity detection"
	default ""
	help
	  "" - No axis is selected
	  "z" - Z axis
	  "y" - Y axis
	  "x" - X axis
	  To choose multiple axes concatenate desired axes.

config ADXL345_INACTIVITY_AXES
	string "Axes included in inactivity detection"
	default ""
	help
	  "" - No axis is selected
	  "z" - Z axis
	  "y" - Y axis
	  "x" - X axis
	  To choose multiple axes concatenate desired axes.

config ADXL345_ACT_ABS_REF_MODE
	int "Absolute or referenced activity detection mode"
	default 0
	help
	  Unsigned value that sets the ADXL345 activity interrupt
	  mode in either absolute or referenced mode.
	  0 - Absolute mode
	  1 - Referenced mode

config ADXL345_INACT_ABS_REF_MODE
	int "Absolute or referenced inactivity detection mode"
	default 0
	help
	  Unsigned value that sets the ADXL345 inactivity interrupt
	  mode in either absolute or referenced mode.
	  0 - Absolute mode
	  1 - Referenced mode

endif # ADXL345
```

## dts/bindings/sensor/adi,adxl345-common.yaml
```yaml
# Copyright (c) 2024 Patryk Biel
# SPDX-License-Identifier: Apache-2.0

include: sensor-device.yaml

properties:
  int1-gpios:
    type: phandle-array
    description: |
      The INT1 signal defaults to active high as produced by the
      sensor.  The property value should ensure the flags properly
      describe the signal that is presented to the driver.
      The INT2 signal is not supported.
```
